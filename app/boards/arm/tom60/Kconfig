## app/boards/arm/tom60/Kconfig
```kconfig
# Copyright (c) 2021 Nick Winans
# SPDX-License-Identifier: MIT

config BOARD_ENABLE_DCDC
	bool "Enable DCDC mode"
	select SOC_DCDC_NRF52X
	default y
	depends on BOARD_TOM60
config NFCT_PINS_AS_GPIOS
	bool "NCFT pins as GPIOs"
	depends on HAS_HW_NRF_NFCT && SOC_FAMILY_NRF
```
